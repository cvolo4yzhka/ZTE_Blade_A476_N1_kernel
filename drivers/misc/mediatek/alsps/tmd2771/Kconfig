## drivers/misc/mediatek/alsps/tmd2771/Kconfig
```kconfig
config MTK_TMD2771
	bool "TMD2771 for MediaTek package"
	default n
	help
	It support different type sensor
	in this platform. If this option
	is set, it will support ambient
	and light sensor TMD2771.
```
